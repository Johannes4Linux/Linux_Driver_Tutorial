/dts-v1/;
/plugin/;

/ {
	fragment@0 {
		target-path = "/";
		__overlay__ {
			my_dev_label: my_device {
				compatible = "brightlight,mydev";
				status = "okay";
				interrupts-extended = <&gpio 20 2>;
			};
		};
	};
};
