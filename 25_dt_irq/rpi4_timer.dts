/dts-v1/;
/plugin/;

/ {
	fragment@0 {
		target-path = "/";

		__overlay__ {
			#address-cells = <2>;
			#size-cells = <1>;
			
			interrupt-parent = <&gicv2>;

			my_timer@fe00b400 {
				compatible = "arm,my_timer";
				status = "okay";
				reg = <0x00 0xfe00b400 0x40>;
				interrupts = <0x00 0x20 0x04>;
			};
		};
	};
};
