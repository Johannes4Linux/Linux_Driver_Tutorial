/dts-v1/;
/plugin/;

/ {
	fragment@0 {
		target-path = "/";

		#address-cells = <2>;
		#size-cells = <1>;

		__overlay__ {
			my_timer@fe00b400 {
				compatible = "arm,my_timer";
				status = "okay";
				reg = <0x00 0xfe00b400 0x40>;
			};
		};
	};
};
